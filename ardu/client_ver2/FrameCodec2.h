#pragma once
// ═════════════════════════════════════════════════════════════════════════
// FrameCodec2.h — 🔴 **`FrameCodec.h` 와 한 몸이다. 성질이 달라서 나뉜 것이 아니다.**
//
// ⚠ **왜 `2` 가 있나**: 이 파일의 코드가 `Modules.h` 를 필요로 해서 그 뒤에 와야 했다.
//   모듈 표가 `client.ino` 머리로 올라간 지금 **그 제약은 사라졌다** — 합칠 수 있다.
//   ⚠ 다만 합치면 코드가 옮겨지므로 `hex` 가 달라진다. **굽기 경계가 필요한 정리다.**
//
// 순서: `FrameCodec.h` → `Modules.h` → **이 파일**
// ═════════════════════════════════════════════════════════════════════════

// ─────────────────────────────────────────────────────────────────────────
// A — ACK (§2.4). R 과 C 둘 다에 대한 응답이다
// ─────────────────────────────────────────────────────────────────────────
static bool sendAck(uint16_t rid, char s0, char s1, uint8_t result) {
  // ✏️ 2026-08-18 — 여기서 프레임을 만들던 코드를 **뺐다.** 배치가 캐시에서 재생성하므로
  //   같은 문자열을 두 곳에서 만들 이유가 없다(`sendSlotBatch` 가 그 일을 한다).
  //   ★ 옛 주석("반환값을 여기서 쓴다 — 못 보냈으면 담아 둔다")의 **목적은 살아 있다**:
  //     ACK 을 잃지 않는 것. **이제는 아예 보내지 않으므로 "못 보냄"이라는 상태가 없다.**
  // 🔴 2026-08-18 (REQ-0185 ①) — **직접 보내지 않는다. 큐에 담기만 한다.**
  //
  // 왜: 여기서 `sendLine` 을 직접 부르면 **슬롯 창을 안 본다.** 게이트만 열려 있으면
  //   ACK 이 **수신 창 한복판에서도 나가고**, 그 송신이 도착 중인 하행과 겹쳐 프레임을 깬다.
  //   창 B 실측: 하행 파괴 5건(`cksumng=5`). 서버가 창을 지켜도 **장치가 그 창에서 송신**했다.
  //   ⚠ 그리고 이 위반은 `[SLOT-OOW]`·`[SLOT]`·`smiss`·`skip` **어디에도 안 잡혔다** —
  //     계측기는 하행 도착과 `statusTick` 경로만 본다. **조용히 새는 형태였다.**
  //
  // ★ 설계 문서가 손실 0 의 직접 원인으로 적은 문장이
  //   **"수신 창에는 한 바이트도 쓰지 않는다"** 인데 **ACK 이 그 문장 밖에 있었다.**
  //   이 수정이 그 문장을 처음으로 참으로 만든다.
  //
  // 🔑 그리고 **유실 경로가 오히려 준다**: 예전에는 "즉시 보내고 실패하면 push" 라
  //   **성공 경로와 실패 경로가 둘**이었다. 이제 **하나**다 — 담고, 배치가 보낸다.
  //   실제 송신은 `sendSlotBatch` 가 하고 그쪽은 **성공했을 때만 큐에서 소비**한다.
  //
  // ⚠ 내용(`s0`·`s1`·`result`)은 담지 않는다 — **호출부가 `ackQ.put()` 을 먼저 부르므로
  //   멱등 캐시가 이미 갖고 있고**, 배치가 보낼 때 거기서 **재생성**한다(재생이 아니다).
  (void)s0; (void)s1; (void)result;
  ackQ.push(rid);
  return true;          // "보냈다"가 아니라 **"담았다"**. 호출부 5곳 모두 반환값을 안 쓴다(확인함)
}

// 🔴 **멱등 커밋 + ACK 예약을 한 번에** (REQ-0273 ②).
//   ⚠ 둘을 따로 부르면 **캐시를 빠뜨린 재전송이 *다른 답*을 받는다**(§4.2 멱등 파손) — 조용히 틀린다.
//   주석으로만 지키던 순서를 **함수로** 지킨다. 호출부(5곳)는 이것만 부른다.
//   🔑 캐시에서 되보내는 재전송 경로(2곳)는 `sendAck` 을 그대로 쓴다 — 그건 이미 캐시에 있다.
//   ★ **거동 근거**: 5곳 전부 `ackQ.put(x)` 바로 뒤 `sendAck(x)` 이고 **인자가 동일**했다.
//     이 함수는 그 쌍을 **그 순서 그대로** 감싼 것뿐이다. ⚠ 다만 `hex` 는 달라진다(+6B) —
//     **"거동 변화 0"을 hex 로 증명할 수는 없고, 소스 대조로만 주장한다.**
static void commitAck(uint16_t rid, char s0, char s1, uint8_t result) {
  ackQ.put(rid, s0, s1, result);
  sendAck(rid, s0, s1, result);
}

// ─────────────────────────────────────────────────────────────────────────
// 🔴 슬롯 배치 — **S 프레임 + 밀린 ACK 를 한 거래로 묶는다** (2026-08-17 · REQ-0164)
//
//   [CIPSEND]  S,912,0110...,P1,3F\nA,7,A1,1,2C\nA,8,B3,1,5D
//
// 왜 묶나: **슬롯당 정확히 1거래**가 규칙이다. 3건을 보내려면 묶는 것 말고 방법이 없다
//   (안 묶으면 3건에 3.6초가 걸린다). **배치는 최적화가 아니라 구조적 필수다.**
//   ⚠ 속도 이득은 1.4배이지 1.9배가 아니다(설계문서 정정). **근거는 속도가 아니라 구조다.**
//
// ⚠ **ACK 는 캐시에서 재생성한다 — 재생(replay)이 아니다.** 큐에는 `rid` 만 있고
//   내용은 멱등 캐시가 갖고 있다. 옛 바이트를 그대로 다시 보내는 것이 아니라 지금 다시 만든다.
//
// 🔑 **성공했을 때만 큐에서 소비한다.** 만들 때는 `peek` 만 하고, `espWrite` 가 참을
//   돌려준 뒤에 그만큼 뺀다. **실패하면 ACK 가 큐에 그대로 남아 다음 슬롯에 다시 나간다.**
//   (옛 `ackqDrain` 은 먼저 빼고 실패 시 되넣는 방식이었다 — 배치에서는 순서가 뒤집힐 수 있어
//    쓸 수 없다. 이쪽이 손실 경로가 아예 없다.)
static bool sendSlotBatch(uint8_t* ackOut, uint16_t* bytesOut) {
  char buf[BATCH_CAP + 1];

  // ── 0) 🔴 등록이 밀려 있으면 **이 슬롯은 `D` 만 보낸다** (socket 명세 §5) ──
  //   ⚠ **`regPending` 은 첫 `S` 가 나간 뒤에야 선다**(`regAfterS` → 아래 성공 처리부).
  //     그래서 이 갈래는 **둘째 슬롯부터** 걸린다. 첫 슬롯은 아래 `S` 경로로 간다.
  //   왜 `S` 와 같이 안 보내나: `D` 여러 줄 + `S` 는 상행 배치 상한을 넘는다.
  //   **슬롯을 가르는 것이 명세의 답이고, 그래서 순서가 구조적으로 보장된다**
  //   (접속 → 첫 슬롯 `D` → 둘째 슬롯부터 `S`).
  //
  //   ⚠ **이 슬롯의 `S` 는 안 나간다.** 서버 입장에서 "첫 프레임까지의 시간"이 한 슬롯
  //     (1.2초) 늘어난다 — **고장이 아니라 등록 축의 예상된 값이다**(PLAN-axes 축 2).
  //
  //   ⚠ **등록 성공을 장치는 모른다**(ACK 이 없다). 그래도 그대로 간다 —
  //     **알아도 할 일이 없기 때문**이다. 서버가 `Q` 를 보내면 다시 보내고, 그것이 유일한 행동이다.
  //     🔑 사람은 정확히 안다(`node_unregistered` · 화면 `⏱`). **모르는 것은 장치뿐이고
  //     장치가 그걸 알아서 바꿀 동작이 없다** → 공백이 아니라 **명시된 비대칭**이다.
  if (regPending) {
    const uint16_t rn = buildRegistration(buf, sizeof buf);
    if (rn == 0) {
#if DEBUG
      Serial.println(F("[REG] 등록 배치를 만들지 못했다 — 잘린 등록을 내보내지 않는다"));
#endif
      return false;                       // ⚠ 다음 슬롯에 다시 시도한다(regPending 유지)
    }
    const bool okReg = espWrite(buf, rn);
    if (okReg) {
      regPending = false;                 // ★ 성공했을 때만 내린다 — ACK 큐와 같은 규율이다
      if (regSends < 65535) regSends++;
    }
    if (ackOut)   *ackOut = 0;
    if (bytesOut) *bytesOut = rn;
#if DEBUG
    Serial.print(F("[REG] 등록 "));
    Serial.print(okReg ? F("전송 ") : F("실패 "));
    Serial.print(rn); Serial.println(F("B"));
#endif
    return okReg;
  }

  // ── 1) 반송파: S 프레임은 **보낼 게 없어도 나간다** ─────────────────────
  //   이 한 프레임이 셋을 겸한다: 반송파 · 생존 신호 · **슬롯 시작 통보**(서버의 t0).
  const uint8_t sn = buildStatus(buf, 64);
  if (sn == 0) return false;
  uint16_t used = sn;

  // ── 2) head 쪽에서 **만들 수 없는 것**부터 걷어낸다 ──────────────────────
  //   캐시에서 밀려났으면 내용을 만들 방법이 없다. 큐도 캐시도 FIFO 라 오래된 쪽에서 난다.
  ackQ.dropUnbuildable();          // 🔴 캐시가 있어야 판정되는 일이라 **큐가 스스로 한다**

  // ── 3) 담을 수 있는 만큼 이어 붙인다 (아직 큐에서 빼지 않는다) ───────────
  uint8_t take = 0;
  while (take < ackQ.pending()) {
    const uint16_t rid = ackQ.peek(take);
    const int8_t   hit = ackQ.find(rid);
    if (hit < 0) break;                       // 중간 미스 — 다음 슬롯에서 걷어낸다

    char one[24];
    int m = snprintf(one, sizeof(one), "A,%u,%c%c,%u,",
                     (unsigned int)ackQ.at(hit).rid,
                     ackQ.at(hit).slot[0], ackQ.at(hit).slot[1],
                     (unsigned int)ackQ.at(hit).result);
    if (m <= 0 || (unsigned)m + 3 > sizeof(one)) break;
    appendChecksum(one, (uint8_t)m);
    const uint8_t ol = (uint8_t)strlen(one);

    if (used + 1 + ol > BATCH_CAP) break;     // 이번 배치엔 자리가 없다 — 다음 슬롯으로 민다
    buf[used++] = '\n';                       // 줄 구분자. 서버 파서는 LF 로 가른다
    // 🔴 **NUL 까지 복사한다**(`ol + 1`). 전선은 `espWrite(buf, used)` 로 **길이 기반**이라
    //   안 닫아도 안 깨진다 — 그런데 **진단 `[TX]` 줄은 `Serial.println(buf)` 로 NUL 종단**이다.
    //   안 닫으면 **앞선 호출이 그 스택 자리에 남긴 바이트까지 찍혀** 로그가 전선에 없던
    //   글자를 보여 준다. 실기에서 `…A,471,G5,0,31` 이 `…315` 로 찍혔다.
    //   🔑 `buildRegistration` 은 처음부터 `ll + 1` 로 복사했다. **같은 관용으로 맞춘다.**
    memcpy(buf + used, one, (size_t)ol + 1);
    used += ol;
    take++;
  }

  const bool ok = espWrite(buf, used);

  // ── 4) **성공했을 때만** 소비한다 ────────────────────────────────────────
  if (ok && take) {
    ackQ.consume(take);
  }
  // 🔴 **`S` 가 실제로 나갔으면 그때 등록을 예약한다.**
  //   이 `S` 가 서버에서 **승격**(소켓 → 노드)을 만든다. 그 뒤라야 `D` 가 처리된다.
  //   ⚠ **성공했을 때만** 세운다 — ACK 큐를 성공 시에만 소비하는 것과 같은 규율이다.
  //     실패했으면 승격이 안 됐을 수 있고, 그러면 다음 슬롯의 `S` 가 다시 시도한다.
  if (ok && regAfterS) { regAfterS = false; regPending = true; }
  if (ackOut)   *ackOut   = take;
  if (bytesOut) *bytesOut = used;
  return ok;
}


